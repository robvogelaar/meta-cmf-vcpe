## conf/layer.conf
```bitbake
# We have a conf and classes directory, add to BBPATH
BBPATH .= ":${LAYERDIR}"

# We have recipes-* directories, add to BBFILES
BBFILES += "${LAYERDIR}/recipes-*/*/*.bb \
            ${LAYERDIR}/recipes-*/*/*.bbappend"

BBFILE_COLLECTIONS += "meta-cmf-vcpe-lxc"
BBFILE_PATTERN_meta-cmf-vcpe-lxc = "^${LAYERDIR}/"
BBFILE_PRIORITY_meta-cmf-vcpe-lxc = "15"

LAYERDEPENDS_meta-cmf-vcpe-lxc = "core"
LAYERSERIES_COMPAT_meta-cmf-vcpe-lxc = "kirkstone"
```

## conf/machine/include/qemux86-soc.inc
```bitbake
##########################################################################
# ============================================================================
# RDK MANAGEMENT, LLC CONFIDENTIAL AND PROPRIETARY
# ============================================================================
# This file (and its contents) are the intellectual property of RDK Management, LLC.
# It may not be used, copied, distributed or otherwise disclosed in whole or in
# part without the express written permission of RDK Management, LLC.
# ============================================================================
# Copyright (c) 2018 RDK Management, LLC. All rights reserved.
# ============================================================================
##########################################################################
MACHINEOVERRIDES =. "qemux86:"

PREFERRED_PROVIDER_virtual/gst-plugins-playersinkbin = "gst-plugins-playersinkbin-emulator"
PREFERRED_PROVIDER_virtual/iarmmgrs-hal = "iarmmgrs-hal-emulator"
PREFERRED_PROVIDER_virtual/devicesettings-hal = "devicesettings-hal-emulator"
PREFERRED_PROVIDER_virtual/closedcaption-hal = "closedcaption-hal"
PREFERRED_PROVIDER_virtual/rf4ce = "rf4ce-dummy"
PREFERRED_PROVIDER_virtual/mfrlib ?= "mfrlib-emulator"
PREFERRED_PROVIDER_virtual/tdksm = "tdksm-autotools"

# Qemu / RDK Emulator config
MACHINE_EXTRA_RDEPENDS += "vboxguestdrivers kernel-module-snd-intel8x0 kernel-module-vmwgfx"

APPEND_append_qemux86 = " quiet splash"

IMAGE_FSTYPES = "tar.gz wic.vmdk"

# OE 2.4 builds currently use wic to create vmdk images and wic depends on the
# GPLv3 grub-efi package by default when building for x86. Manually removing
# the dependency allows GPLv3 free builds to complete. To be reviewed.
WKS_FILE_DEPENDS_BOOTLOADERS_remove = "grub-efi"

SYSLINUX_ROOT = "root=/dev/hda2"

IMAGE_FEATURES = "read-only-rootfs"
DISTRO_FEATURES_append = " webconfig_bin"
DISTRO_FEATURES_append = " thunder_security_disable"
DISTRO_FEATURES_append = " gstreamer1_18"

# To fix issue with preferred version configuration from rdkv.inc has no effect
PREFERRED_VERSION_wpeframework = "${@bb.utils.contains('DISTRO_FEATURES', 'wpe_r4_4', '4.4%' , bb.utils.contains('DISTRO_FEATURES', 'wpe_r4', '4.2%', '2.1%', d), d)}"
PREFERRED_VERSION_wpeframework-clientlibraries = "${@bb.utils.contains('DISTRO_FEATURES', 'wpe_r4_4', '4.4%' , bb.utils.contains('DISTRO_FEATURES', 'wpe_r4', '4.2%', '2.1%', d), d)}"
PREFERRED_VERSION_wpeframework-interfaces = "${@bb.utils.contains('DISTRO_FEATURES', 'wpe_r4_4', '4.4%' , bb.utils.contains('DISTRO_FEATURES', 'wpe_r4', '4.2%', '2.1%', d), d)}"
PREFERRED_VERSION_wpeframework-tools-native = "${@bb.utils.contains('DISTRO_FEATURES', 'wpe_r4_4', '4.4%' , bb.utils.contains('DISTRO_FEATURES', 'wpe_r4', '4.2%', '2.1%', d), d)}"
```

## conf/machine/vcpex86broadband.conf
```bitbake
##########################################################################
# ============================================================================
# RDK MANAGEMENT, LLC CONFIDENTIAL AND PROPRIETARY
# ============================================================================
# This file (and its contents) are the intellectual property of RDK Management, LLC.
# It may not be used, copied, distributed or otherwise disclosed in whole or in
# part without the express written permission of RDK Management, LLC.
# ============================================================================
# Copyright (c) 2018 RDK Management, LLC. All rights reserved.
# ============================================================================
##########################################################################
#@TYPE: Machine
#@NAME: qemux86broadband
#@RDK_FLAVOR: rdkb
#@NEEDED_BSPLAYERS: meta-rdk-bsp-emulator
#@DESCRIPTION: Machine configuration for running a RDK mediaclient on x86

require conf/machine/qemux86.conf
require include/qemux86-soc.inc
require conf/include/rdk-bbmasks-rdkb-emulator.inc

MACHINE_IMAGE_NAME = "X86EMLTRBB"

#set generic RDK settings for this device
#set RMF platform type (broadband, hybrid, or client)
MACHINEOVERRIDES .= ":broadband"
MACHINEOVERRIDES .= ":qemux86broadband"

DISTRO_FEATURES_append = " parodus bluez5 referencepltfm "
DISTRO_FEATURES_append = " WanFailOverSupportEnable"
# RDKB-44824: CoreNetLib move bb file location
DISTRO_FEATURES_append_broadband = " core-net-lib"
DISTRO_FEATURES_append_broadband = " rdkb_wan_manager"
DISTRO_FEATURES_append_broadband = " WanManagerUnificationEnable"
DISTRO_FEATURES_append_broadband = " halVersion3"

BBMASK .= "|.*meta-rdk-comcast-broadband/recipes-rdkb/hostapd|.meta-rdk-ext/recipes-core/glib-networking/glib-networking_2.48.2.bb"

MACHINE_EXTRA_RRECOMMENDS += "kernel-module-rtl8812au kernel-module-8192eu kernel-module-88x2bu"

PREFERRED_VERSION_lighttpd = "1.4.53"
PREFERRED_VERSION_nmap = "7.80"
PREFERRED_VERSION_python3-jinja2-native = "3.1.1"
PREFERRED_PROVIDER_hal-wifi = "hal-wifi-cfg80211"
```
